#include "ssd1306.h"
#include <string.h>
#include "driver/i2c.h"
#include "esp_log.h"

#define I2C_NUM I2C_NUM_0
#define SSD1306_ADDR 0x3C

static const char* TAG = "ssd1306";
static uint8_t framebuffer[1024];

// Simple 5x7 ASCII font table (from ' ' to '~', ASCII 32 to 126)
static const uint8_t font5x7[95][5] = {
    {0x00, 0x00, 0x00, 0x00, 0x00}, // 32: Space
    {0x00, 0x00, 0x5f, 0x00, 0x00}, // 33: !
    {0x00, 0x07, 0x00, 0x07, 0x00}, // 34: "
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    {0x02, 0x01, 0x02, 0x04, 0x02}  // 126: ~
};

static esp_err_t ssd1306_write(uint8_t address, uint8_t reg, uint8_t* data, size_t len) {
    i2c_cmd_handle_t cmd = i2c_cmd_link_create();
    i2c_master_start(cmd);
    i2c_master_write_byte(cmd, (address << 1) | I2C_MASTER_WRITE, true);
    i2c_master_write_byte(cmd, reg, true);
    if (len > 0) {
        i2c_master_write(cmd, data, len, true);
    }
    i2c_master_stop(cmd);
    esp_err_t ret = i2c_master_cmd_begin(I2C_NUM, cmd, pdMS_TO_TICKS(100));
    i2c_cmd_link_delete(cmd);
    return ret;
}

static void ssd1306_command(uint8_t cmd) {
    ssd1306_write(SSD1306_ADDR, 0x00, &cmd, 1);
}

void ssd1306_init(int sda_pin, int scl_pin) {
    i2c_config_t conf = {};
    conf.mode = I2C_MODE_MASTER;
    conf.sda_io_num = sda_pin;
    conf.sda_pullup_en = GPIO_PULLUP_ENABLE;
    conf.scl_io_num = scl_pin;
    conf.scl_pullup_en = GPIO_PULLUP_ENABLE;
    conf.master.clk_speed = 400000;
    
    esp_err_t err = i2c_param_config(I2C_NUM, &conf);
    if (err != ESP_OK) {
        ESP_LOGE(TAG, "I2C param config failed");
        return;
    }
    err = i2c_driver_install(I2C_NUM, conf.mode, 0, 0, 0);
    if (err != ESP_OK) {
        ESP_LOGE(TAG, "I2C driver install failed");
        return;
    }

    vTaskDelay(pdMS_TO_TICKS(100));

    ssd1306_command(0xAE); // Display off
    ssd1306_command(0xD5); // Set display clock divide ratio/oscillator frequency
    ssd1306_command(0x80);
    ssd1306_command(0xA8); // Set multiplex ratio
    ssd1306_command(0x3F); // 64 mux
    ssd1306_command(0xD3); // Set display offset
    ssd1306_command(0x00);
    ssd1306_command(0x40); // Set start line to 0
    ssd1306_command(0x8D); // Charge pump
    ssd1306_command(0x14); // Enable charge pump
    ssd1306_command(0x20); // Memory addressing mode
    ssd1306_command(0x00); // Horizontal mode
    ssd1306_command(0xA1); // Segment remap (flip)
    ssd1306_command(0xC8); // COM output scan direction (flip)
    ssd1306_command(0xDA); // COM pins hardware configuration
    ssd1306_command(0x12);
    ssd1306_command(0x81); // Contrast control
    ssd1306_command(0xCF);
    ssd1306_command(0xD9); // Pre-charge period
    ssd1306_command(0xF1);
    ssd1306_command(0xDB); // VCOMH deselect level
    ssd1306_command(0x40);
    ssd1306_command(0xA4); // Entire display on (output follow RAM)
    ssd1306_command(0xA6); // Normal display (not inverted)
    ssd1306_command(0xAF); // Display on

    ssd1306_clear();
    ssd1306_update();
    ESP_LOGI(TAG, "OLED init successful");
}

void ssd1306_clear(void) {
    memset(framebuffer, 0, sizeof(framebuffer));
}

void ssd1306_draw_pixel(int x, int y, int color) {
    if (x < 0 || x >= SSD1306_WIDTH || y < 0 || y >= SSD1306_HEIGHT) {
        return;
    }
    int page = y / 8;
    int bit = y % 8;
    int index = page * SSD1306_WIDTH + x;
    if (color) {
        framebuffer[index] |= (1 << bit);
    } else {
        framebuffer[index] &= ~(1 << bit);
    }
}

void ssd1306_draw_char(int x, int y, char c, int color) {
    if (c < 32 || c > 126) {
        c = '?'; // fallback
    }
    int idx = c - 32;
    for (int col = 0; col < 5; col++) {
        uint8_t line = font5x7[idx][col];
        for (int row = 0; row < 7; row++) {
            if (line & (1 << row)) {
                ssd1306_draw_pixel(x + col, y + row, color);
            } else {
                ssd1306_draw_pixel(x + col, y + row, !color ? 1 : 0);
            }
        }
    }
}

void ssd1306_draw_string(int x, int y, const char* str, int color) {
    while (*str) {
        ssd1306_draw_char(x, y, *str, color);
        x += 6; // font size is 5x7 + 1 spacing
        if (x >= SSD1306_WIDTH) {
            break;
        }
        str++;
    }
}

void ssd1306_draw_line(int x0, int y0, int x1, int y1, int color) {
    int dx = abs(x1 - x0), sx = x0 < x1 ? 1 : -1;
    int dy = -abs(y1 - y0), sy = y0 < y1 ? 1 : -1;
    int err = dx + dy, e2;

    while (1) {
        ssd1306_draw_pixel(x0, y0, color);
        if (x0 == x1 && y0 == y1) break;
        e2 = 2 * err;
        if (e2 >= dy) { err += dy; x0 += sx; }
        if (e2 <= dx) { err += dx; y0 += sy; }
    }
}

void ssd1306_draw_box(int x, int y, int w, int h, int color, bool fill) {
    if (fill) {
        for (int i = 0; i < w; i++) {
            for (int j = 0; j < h; j++) {
                ssd1306_draw_pixel(x + i, y + j, color);
            }
        }
    } else {
        ssd1306_draw_line(x, y, x + w - 1, y, color);
        ssd1306_draw_line(x, y + h - 1, x + w - 1, y + h - 1, color);
        ssd1306_draw_line(x, y, x, y + h - 1, color);
        ssd1306_draw_line(x + w - 1, y, x + w - 1, y + h - 1, color);
    }
}

void ssd1306_update(void) {
    ssd1306_command(0x21); // Column address
    ssd1306_command(0);
    ssd1306_command(127);
    ssd1306_command(0x22); // Page address
    ssd1306_command(0);
    ssd1306_command(7);

    // Send 1024 bytes data
    ssd1306_write(SSD1306_ADDR, 0x40, framebuffer, sizeof(framebuffer));
}
